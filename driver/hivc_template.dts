/dts-v1/;
/ {
	fragment {
		target-path = "/";
		__overlay__ {
			axvisor_ivc_device {
				compatible = "axvisor";
				/* added dynamically
				interrupts = <0x00 0x22 0x01>;				
				*/
			};
		};
	};
};
